#include <dt-bindings/zmk/matrix_transform.h>
#include <physical_layouts.dtsi>
#include "forager.dtsi"


/ {
   chosen {
      zmk,kscan = &mock_kscan;
   };

   mock_kscan: kscan_1 {
      compatible = "zmk,kscan-mock";
      columns = <0>;
      rows = <0>;
      events = <0>;
   };
};
