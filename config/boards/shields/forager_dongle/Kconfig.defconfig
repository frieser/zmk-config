## config/boards/shields/forager_dongle/Kconfig.defconfig
```kconfig
# Copyright (c) 2022 The ZMK Contributors
# SPDX-License-Identifier: MIT

if SHIELD_FORAGER_DONGLE

config ZMK_KEYBOARD_NAME
    default "Forager Dongle"

config ZMK_SPLIT_ROLE_CENTRAL
    default y

config ZMK_SPLIT
    default y

if ZMK_DISPLAY

config I2C
    default y

endif # ZMK_DISPLAY

if LVGL

config LV_Z_VDB_SIZE
    default 64

config LV_DPI_DEF
    default 148

config LV_Z_BITS_PER_PIXEL
    default 1

choice LV_COLOR_DEPTH
    default LV_COLOR_DEPTH_1
endchoice

endif # LVGL

endif # SHIELD_FORAGER_DONGLE

#vim: set ft=kconfig:
```

## config/boards/shields/forager_dongle/Kconfig.shield
```kconfig
# Copyright (c) 2022 The ZMK Contributors
# SPDX-License-Identifier: MIT

config SHIELD_FORAGER_DONGLE
    def_bool $(shields_list_contains,forager_dongle)

#vim: set ft=kconfig:
```

## config/boards/shields/totem_dongle/Kconfig.shield
```kconfig
# Copyright (c) 2022 The ZMK Contributors
# SPDX-License-Identifier: MIT

config SHIELD_TOTEM_DONGLE
    def_bool $(shields_list_contains,totem_dongle)

#vim: set ft=kconfig:
```
