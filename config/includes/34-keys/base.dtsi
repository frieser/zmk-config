/* Forager / Urchin (34 keys): family adapter.
 *
 * Include order: the family layout header first (behaviours.dtsi needs
 * KEYS_L / KEYS_R / THUMBS), then the shared include contract, then the
 * shared layer assembly. The six layer slices live in ../layers/34-keys/.
 */
#include "../../layouts/34-keys.h"
#include "../common.dtsi"

/* Where ../keymap.dtsi finds this family's layer slices. */
#define ZMK_KEYMAP_LAYER_BASE    "layers/34-keys/base.dtsi"
#define ZMK_KEYMAP_LAYER_SYMBOL  "layers/34-keys/symbol.dtsi"
#define ZMK_KEYMAP_LAYER_NAVI    "layers/34-keys/navi.dtsi"
#define ZMK_KEYMAP_LAYER_NUMPAD  "layers/34-keys/numpad.dtsi"
#define ZMK_KEYMAP_LAYER_MACRO   "layers/34-keys/macro.dtsi"
#define ZMK_KEYMAP_LAYER_DEBUG   "layers/34-keys/debug.dtsi"

#include "../keymap.dtsi"
