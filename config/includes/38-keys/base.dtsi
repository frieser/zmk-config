/* Totem (38 keys): family adapter.
 *
 * Include order: the family layout header first (behaviours.dtsi needs
 * KEYS_L / KEYS_R / THUMBS), then the shared include contract, then the
 * shared layer assembly. The six layer slices live in ../layers/38-keys/.
 */
#include "../../layouts/38-keys.h"
#include "../common.dtsi"

/* Where ../keymap.dtsi finds this family's layer slices. */
#define ZMK_KEYMAP_LAYER_BASE    "layers/38-keys/base.dtsi"
#define ZMK_KEYMAP_LAYER_SYMBOL  "layers/38-keys/symbol.dtsi"
#define ZMK_KEYMAP_LAYER_NAVI    "layers/38-keys/navi.dtsi"
#define ZMK_KEYMAP_LAYER_NUMPAD  "layers/38-keys/numpad.dtsi"
#define ZMK_KEYMAP_LAYER_MACRO   "layers/38-keys/macro.dtsi"
#define ZMK_KEYMAP_LAYER_DEBUG   "layers/38-keys/debug.dtsi"

#include "../keymap.dtsi"
