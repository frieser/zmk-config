
/ {
    combos {
        compatible = "zmk,combos";

        cb_m {
            bindings = <&kp TAB>;
            key-positions = <LM3 LM2 LM1>;
            layers = <BASE SYMBOL>;
        };

        cb_enter {
            bindings = <&kp RET>;
            key-positions = <RM1 RM2 RM3>;
            layers = <BASE SYMBOL>;
        };
    };
};
