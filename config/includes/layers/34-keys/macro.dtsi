/* Forager / Urchin (34 keys) - Macro_layer.  Assembled by ../../keymap.dtsi. */
        Macro_layer {
            display-name = "Macro";

            bindings = <LAYER_FROM34( \
&none,           &none, &none, &none, &none,               &none, &none, &none, &none, &none,             
&none,           &none, &none, &none, &none,               &none, &none, &none, &none, &none,             
&email_macro,    &none, &none, &none, &none,               &none, &none, &none, &none, &my_user_macro,    
                            &none, &none,                  &none, &none 
            )>;
        };
