
/ {
    macros {
        email_macro: email_macro {
            compatible = "zmk,behavior-macro";
            #binding-cells = <0>;
            wait-ms = <10>;
            tap-ms = <10>;
            bindings
                    = <&kp F &kp R &kp I &kp E &kp S &kp E &kp R &kp P &kp A &kp L &kp D &kp I>
                    , <&kp AT>  /* @ */
                    , <&kp G &kp M &kp A &kp I &kp L &kp DOT &kp C &kp O &kp M>
                    ;
        };
        my_user_macro: my_user_macro {
            compatible = "zmk,behavior-macro";
            #binding-cells = <0>;
            wait-ms = <10>;  
            tap-ms = <10>;
            bindings = <&kp E &kp N0 &kp N5 &kp N3 &kp N2 &kp N7 &kp N4>;
        };
    };
};
