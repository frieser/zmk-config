#include <dt-bindings/zmk/pointing.h>
#include <input/processors.dtsi>

#define ZMK_POINTING_DEFAULT_SCRL_VAL 100   // default: 10
#define ZMK_POINTING_DEFAULT_MOVE_VAL 1200  // default: 600
// HM_TAPPING_* / HM_PRIOR_IDLE live in behaviours.dtsi (single definition).

&mmv {
    acceleration-exponent = <1>;      // 1
    time-to-max-speed-ms = <500>;     // 300
    trigger-period-ms = <16>;
};

&msc {
    acceleration-exponent = <1>;      // 0
    time-to-max-speed-ms = <70>;      // 300
    trigger-period-ms = <16>;
};
